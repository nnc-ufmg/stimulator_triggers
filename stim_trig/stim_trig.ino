  #include "Arduino.h"


/*
  
inline void digitalWriteDirect(int pin, boolean val){
  if(val) g_APinDescription[pin].pPort -> PIO_SODR = g_APinDescription[pin].ulPin;
  else    g_APinDescription[pin].pPort -> PIO_CODR = g_APinDescription[pin].ulPin;
}

inline int digitalReadDirect(int pin){
  return !!(g_APinDescription[pin].pPort -> PIO_PDSR & g_APinDescription[pin].ulPin);
}

*/

/*
 * Interrupt Numbers
 * 
 * BOARD INT.0 INT.1 INT.2 INT.3 INT.4 INT.5
 * Uno, Ethernet 2 3
 * Mega2560  2 3 21  20  19  18  
 * 32u4 based (e.g Leonardo, Micro)  3 2 0 1 7  
 * 
 */

 
const byte interruptPin = 21;       //This is the ON/OFF switch form the trigger

unsigned long square_length = 100;          // in microseconds
unsigned long square_interval = 5;          // in microseconds
unsigned long ulTIMElast,ulTIMEread;
int ulIcount; 
bool bStart=false;

//////////////////////////////////

// Delta T samples gerados no matlab.
#define deltaT_samples 720

unsigned long  chinterval[deltaT_samples] = {
  80384,169615,61268,188731,250000,15840,81091,20000,74776,20000,34974,3316,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40601
};
static byte chnumber[deltaT_samples] = {
  2,3,2,3,3,1,2,2,1,1,1,3,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3
};

static byte chpinP[8] = {
  2,3,4,5,6,7,8,9
  };
static byte chpinN[8] = {
  12,13,14,15,16,17,18,19
  };
///////////////////////////////////

void setup()
{
    for (int i = 0; i < 8; i++) 
      {
      pinMode(chpinP[i], OUTPUT);
      pinMode(chpinN[i], OUTPUT);
      digitalWrite(chpinP[i], LOW);
      digitalWrite(chpinN[i], LOW);
      //delayMicroseconds(1);
      }
     ulTIMElast = micros();
     ulIcount=0;
     
     pinMode(interruptPin, INPUT);
     attachInterrupt(digitalPinToInterrupt(interruptPin), OnOffSwitch, CHANGE);  
}

void loop() 
{
  ulTIMEread=micros();
  if (bStart)
      if ((ulTIMEread-ulTIMElast)>chinterval[ulIcount])
        {
          //Let's trigger a stimuli
          digitalWrite(chpinP[chnumber[ulIcount]],HIGH);
          delayMicroseconds(square_length);
          digitalWrite(chpinP[chnumber[ulIcount]],LOW);
          delayMicroseconds(square_interval);
          digitalWrite(chpinN[chnumber[ulIcount]],HIGH);
          delayMicroseconds(square_length);
          digitalWrite(chpinN[chnumber[ulIcount]],LOW);
          
          ulIcount++;
          if(ulIcount>=deltaT_samples) ulIcount=0;
          ulTIMElast=ulTIMEread;
        }
  //Just in case clock runs wholhe unsigned long 72min numbers
  //if (ulTIMEread<ulTIMElast) ulTIMElast=ulTIMEread; // We can fix this better by subtracting from chinterval[ulIcount]
}



void OnOffSwitch() 
{
  if (digitalRead(interruptPin))
    {
      ulIcount=0;
      ulTIMElast = micros();
      bStart=true; 
      
    } else  {
            bStart=false; 
            }
}
